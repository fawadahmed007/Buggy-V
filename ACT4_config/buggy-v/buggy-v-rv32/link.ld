OUTPUT_ARCH("riscv")
ENTRY(rvtest_entry_point)

SECTIONS
{
  . = /* TODO */;

  .text.init : { /* TODO */ }
  .text      : { /* TODO */ }
  .data      : { /* TODO */ }
  .bss       : { /* TODO */ }

  /* TODO: add alignment and end symbol(s) */
}
